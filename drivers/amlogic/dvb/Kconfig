## drivers/amlogic/dvb/Kconfig
```kconfig
#
# Smart card driver configuration
#

menu "AMLOGIC DVB driver"

config AM_DVB
	tristate "AMLOGIC DVB driver"
	default n
	depends on DVB_CORE
	help
		Select to enable AMLogic DVB driver.

config AMLOGIC_S_TS0
	bool "Serial TS0"
	default n
	depends on AM_DVB
	help
		TS0 in serial mode.

config AMLOGIC_S_TS1
	bool "Serial TS1"
	default n
	depends on AM_DVB
	help
		TS1 in serial mode.

config AMLOGIC_S_TS2
	bool "Serial TS2"
	default n
	depends on AM_DVB
	help
		TS0 in serial mode.

config AM_GX1001
	tristate "GX1001 demod driver"
	default n
	depends on AM_DVB
	help
		Select to enable GX1001 demod driver.
		
config AM_MXL101
	tristate "MXL101 demod driver"
	default n
	depends on AM_DVB
	help
		Select to enable MXL101 demod driver.
		
#config AM_AVL6211
#	tristate "AVL6211 demod driver"
#	default n
#	depends on AM_DVB
#	help
#		Select to enable AVL6211 demod driver.		
		
config AM_ITE9173
	tristate "ITE9173 demod driver"
	default n
	depends on AM_DVB
	help
		Select to enable ITE9173 demod driver.	

config AM_RTL2830
	tristate "RTL2830 demod driver"
	default n
	depends on AM_DVB
	help
		Select to enable RTL2830 demod driver.	
		
config AM_DS3000
	tristate "DS3000 demod driver"
	default n
	depends on AM_DVB
	help
		Select to enable DS3000 demod driver.	
config TH_SONY_T2
	tristate "sony demod driver"
	default n
	depends on AM_DVB
	help
		Select to enable sony demod driver.		

config AM_ITE9133
	tristate "ITE9133 demod driver"
	default n
	depends on AM_DVB
	help
		Select to enable ITE9133 demod driver.	
		
config AM_MN88436
	tristate "MN88436 demod driver"
	default n
	depends on AM_DVB
	help
		Select to enable MN88436 demod driver.	
		
config AM_SI2168
	tristate "SI2168 demod driver"
	default n
	depends on AM_DVB
	help
		Select to enable SI2168 demod driver.

source "drivers/amlogic/dvb/dib7090/Kconfig" 

source "drivers/amlogic/dvb/avl6211/Kconfig" 

endmenu
```

## drivers/amlogic/dvb/avl6211/Kconfig
```kconfig
#
# AVL6211 driver configuration
#

menuconfig AM_AVL6211
	tristate "AVL6211 demod driver"
	default n
	depends on AM_DVB
	help
		Select to enable AVL6211 demod driver.		


if AM_AVL6211

config AVL6211_LNB_DEMOD_GPIO
	bool "demod gpio ctrl"
	depends on AM_AVL6211
	default n
	help
	 AVL6211_LNB_DEMOD_GPIO mode(for mother board)

config AVL_Spectrum_Invert
	bool "Spectrum_Invert"
	depends on AM_AVL6211
	default n
	help
	 Spectrum_Invert(for mother board)

endif
```

## drivers/amlogic/dvb_tv/Kconfig
```kconfig
#
# Smart card driver configuration
#

menu "AMLOGIC DVB driver"

config AM_DVB
	tristate "AMLOGIC DVB driver"
	default n
	depends on DVB_CORE
	help
		Select to enable AMLogic DVB driver.

config AMLOGIC_TS0
	bool "Enable TS0"
	default n
	depends on AM_DVB
	help
		Enable TS0.

config AMLOGIC_TS1
	bool "Enable TS1"
	default n
	depends on AM_DVB
	help
		Enable TS1.

config AMLOGIC_TS2
	bool "Enable TS2"
	default n
	depends on AM_DVB
	help
		Enable TS2.

config AMLOGIC_S_TS0
	bool "Serial TS0"
	default n
	depends on AM_DVB
	help
		TS0 in serial mode.

config AMLOGIC_S_TS1
	bool "Serial TS1"
	default n
	depends on AM_DVB
	help
		TS1 in serial mode.

config AMLOGIC_S_TS2
	bool "Serial TS2"
	default n
	depends on AM_DVB
	help
		TS0 in serial mode.

config AM_MXL101
	tristate "MXL101 demod driver"
	default n
	depends on AM_DVB
	help
		Select to enable MXL101 demod driver.
		
config AM_AVL6211
	tristate "AVL6211 demod driver"
	default n
	depends on AM_DVB
	help
		Select to enable AVL6211 demod driver.		
		
config AM_MN88436
	tristate "MN88436 demod driver"
	default n
	depends on AM_DVB
	help
		Select to enable MN88436 demod driver.		


endmenu
```

## drivers/amlogic/hdmi/Kconfig
```kconfig
menu "Amlogic HDMI TX Support"


config AML_HDMI_TX
        tristate "HDMI Output Enable"
        default y
        help  
                hdmi output enable,It should be enalbe if board have hdmi out interface
endmenu
```

## drivers/amlogic/nand/Kconfig
```kconfig
#
# Amlogic NAND device configuration
#

menu "AMLOGIC NAND Flash support"

config AM_NAND
	bool "Amlogic NAND FLASH M1/M2/M3 SUPPORT"
	    depends on AMLOGIC_SERIES
	default y
        select MTD_NAND 
	    select MTD_PARTITIONS
        select MTD_BLOCK
        select MTD_CHAR
        help
		This is Meson_M1 nand suport

config AM_NAND_RBPIN
	bool "use nand rbpin (A3/M3 optional)"
	    depends on AM_NAND
	default y
	
config AML_NAND_ENV
	bool "use aml nand env (/dev/nand_env)"
	    depends on AM_NAND
	default y

config AML_NAND_KEY
	bool "Meson key data store in nand device(dev/nand_key) support"
	depends on AM_NAND
	depends on ARCH_MESON3 || ARCH_MESON6
	default n
	help
	  Support   key variable store in NAND device

config NAND_KEY_BLOCK_NUM
	int "config nand key area block number"
	depends on AML_NAND_KEY
	range 2  16
	default 8
	help
		config nand key block number, the number must be even number

config AML_NFTL
	tristate "Amlogic NFTL (NAND Flash Translation Layer) support"
	depends on (AM_NAND)
	default m
        help
		This is aml nftl suport
		
config AML_NFTL_NEW
	tristate "Meson NAND NEW_FTL support"
	depends on AM_NAND
	default n
	help
	  Support NAND Flash New Translation Layer

endmenu
```
